/*
 * Copyright (c) 2015 NVIDIA CORPORATION. All rights reserved.
 *
 * This software is licensed under the terms of the GNU General Public
 * License version 2, as published by the Free Software Foundation, and
 * may be copied, distributed, and modified under those terms.
 *
 * This program is distributed in the hope that it will be useful,
 * but WITHOUT ANY WARRANTY; without even the implied warranty of
 * MERCHANTABILITY or FITNESS FOR A PARTICULAR PURPOSE.  See the
 * GNU General Public License for more details.
 *
 */

/ {
	cpufreq {
		compatible = "nvidia,tegra124-cpufreq";
		emc-scaling-data {
			emc-cpu-limit-table = <
				/* CPU    EMC */
				51000   12750
				312000  50000
				564000  102000
				696000  204000
				828000  300000
				960000  396000
				1044000 528000
				1224000 600000
				1326000 792000
				1734000 924000
				>;
		};
	};
};
